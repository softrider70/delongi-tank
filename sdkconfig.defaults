## sdkconfig.defaults
```kconfig
# Board-agnostic ESP-IDF configuration defaults
# These settings apply to all boards unless overridden in board-specific files

# ============================================================================
# Project Configuration
# ============================================================================
CONFIG_PROJECT_NAME="${PROJECT_NAME}"
CONFIG_PROJECT_VER="0.1.0"

# ============================================================================
# Application Stack & Task Configuration
# ============================================================================
CONFIG_APP_STACK_SIZE=4096
CONFIG_APP_PRIORITY=5
CONFIG_APP_LOGLEVEL=3

# ============================================================================
# FreeRTOS Configuration
# ============================================================================
CONFIG_FREERTOS_UNICORE=n
CONFIG_FREERTOS_RUN_TIME_STATS_USING_ESP_TIMER=y
CONFIG_FREERTOS_WATCHPOINT_END_OF_STACK=y

# ============================================================================
# Logging
# ============================================================================
CONFIG_LOG_DEFAULT_LEVEL=3
CONFIG_LOG_MAXIMUM_LEVEL=5
CONFIG_LOG_BOOTLOADER_LEVEL=3

# ============================================================================
# NVS (Non-Volatile Storage)
# ============================================================================
CONFIG_NVS_ENCRYPTION_KEY_SIZE=24

# ============================================================================
# Startup Configuration
# ============================================================================
CONFIG_ESP_CONSOLE_UART_NUM=0
CONFIG_ESP_CONSOLE_UART_BAUDRATE=115200

# ============================================================================
# Memory Configuration
# ============================================================================
CONFIG_SPIRAM_USE=y
CONFIG_SPIRAM_USE_MALLOC=y

# ============================================================================
# I2C Configuration (for VL53L0X sensor)
# ============================================================================
CONFIG_I2C_ENABLED=y
CONFIG_I2C_ISR_IRAM_SAFE=y

# ============================================================================
# WiFi Configuration
# ============================================================================
CONFIG_ESP_WIFI_ENABLED=y
CONFIG_ESP_WIFI_SSID=""
CONFIG_ESP_WIFI_PASSWORD=""
CONFIG_WIFI_AP_SSID="delonghi-tank"
CONFIG_WIFI_AP_PASSWORD="12345678"
CONFIG_WIFI_AP_ASSIGN_IP=y
CONFIG_WIFI_AP_IP_ADDR="10.1.1.1"
CONFIG_WIFI_AP_NETMASK_ADDR="255.255.255.0"
CONFIG_WIFI_AP_GATEWAY_ADDR="10.1.1.1"

# ============================================================================
# NVS Flash Encryption
# ============================================================================
CONFIG_NVS_ENCRYPTION=y

# ============================================================================
# HTTP Server Configuration
# ============================================================================
CONFIG_ESP_HTTP_SERVER=y
CONFIG_HTTPD_MAX_URI_LEN=512
CONFIG_HTTPD_MAX_REQ_HDR_LEN=1024
CONFIG_HTTPD_MAX_REQ_LINE_LEN=1024

# ============================================================================
# mDNS Service Discovery
# ============================================================================
CONFIG_MDNS_SERVICE_DISCOVERY=y
CONFIG_MDNS_INSTANCE_NAME="delonghi-tank"

# ============================================================================
# Security (Optional - uncomment for production)
# ============================================================================
# CONFIG_SECURE_BOOT_ENABLED=y
# CONFIG_SECURE_BOOT_V2_ENABLED=y
# CONFIG_SECURE_FLASH_ENC_ENABLED=y
```

## sdkconfig.defaults.esp32
```kconfig
# ESP32 (Dual-core, 520KB SRAM, optional PSRAM)
# This file extends sdkconfig.defaults with ESP32-specific settings

CONFIG_IDF_TARGET="esp32"
CONFIG_ESP32_CHIP_REVISION_AUTO=y

# Real board flash size (verified via esptool flash-id)
CONFIG_ESPTOOLPY_FLASHSIZE_4MB=y
CONFIG_ESPTOOLPY_FLASHSIZE="4MB"

# OTA-ready partition layout (A/B slots)
CONFIG_PARTITION_TABLE_CUSTOM=y
CONFIG_PARTITION_TABLE_CUSTOM_FILENAME="partitions_ota_custom.csv"
CONFIG_PARTITION_TABLE_FILENAME="partitions_ota_custom.csv"
CONFIG_ESP_HTTPS_OTA_ALLOW_HTTP=y

# ESP32 has dual cores, no need for FREERTOS_NO_AFFINITY
CONFIG_FREERTOS_UNICORE=n

# PSRAM configuration (optional, only if your board has PSRAM)
# CONFIG_SPIRAM=y
# CONFIG_SPIRAM_MODE_QUAD=y

# Default to 40MHz if PSRAM not available
CONFIG_ESP32_DEFAULT_CPU_FREQ_160=y
```
